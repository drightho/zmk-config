## config/boards/shields/nice_view_awesomes/Kconfig.shield
```kconfig
config SHIELD_NICE_VIEW_AWESOMES
    def_bool $(shields_list_contains,nice_view_awesomes)
```

## config/boards/shields/touchpad_right/Kconfig.shield
```kconfig
config SHIELD_TOUCHPAD_RIGHT
    def_bool $(shields_list_contains,touchpad_right)
```
